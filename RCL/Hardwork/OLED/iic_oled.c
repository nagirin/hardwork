#include ".\OLED/iic_oled.h"
#include <stdlib.h>

/***************************16*16 dot matrix*********/
uint8_t iic_F16x16[] =

{	
	0x00,0x00,0xF8,0x08,0x08,0x08,0x08,0x09,0x0E,0x08,0x08,0x08,0x08,0x08,0x00,0x00,
	0x80,0x60,0x1F,0x00,0x00,0x00,0x00,0x00,0x00,0x00,0x00,0x00,0x00,0x00,0x00,0x00,/*"广",0*/
	0x00,0x04,0x04,0x04,0x04,0x04,0x04,0xFC,0x04,0x04,0x04,0x04,0x04,0x04,0x00,0x00,
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	0x00,0x7F,0x40,0x50,0x50,0x48,0x44,0x42,0x41,0x42,0x44,0x48,0x50,0x40,0x40,0x00,/*"医",6*/
};


/************************************6*8 dot matrix************************************/
const unsigned char iic_F6x8[][6] =
{
	0x00, 0x00, 0x00, 0x00, 0x00, 0x00,// sp
	0x00, 0x00, 0x00, 0x2f, 0x00, 0x00,// !
	0x00, 0x00, 0x07, 0x00, 0x07, 0x00,// "
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	0x14, 0x14, 0x14, 0x14, 0x14, 0x14,// horiz lines
};
/****************************************8*16 dot matrix************************************/
const unsigned char iic_F8X16[]=	  
{
  0x00,0x00,0x00,0x00,0x00,0x00,0x00,0x00,0x00,0x00,0x00,0x00,0x00,0x00,0x00,0x00,// 0
  0x00,0x00,0x00,0xF8,0x00,0x00,0x00,0x00,0x00,0x00,0x00,0x33,0x30,0x00,0x00,0x00,//! 1
  0x00,0x10,0x0C,0x06,0x10,0x0C,0x06,0x00,0x00,0x00,0x00,0x00,0x00,0x00,0x00,0x00,//" 2
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  0x00,0x06,0x01,0x01,0x02,0x02,0x04,0x04,0x00,0x00,0x00,0x00,0x00,0x00,0x00,0x00,//~ 94
};

unsigned char iic_BMP1[] =
{
 0x00,0x00,0x00,0x00,0x00,0x00,0x00,0x00,0x00,0x00,0x00,0x00,0x00,0x00,0x00,0x00,
 0x00,0x00,0x00,0x00,0x00,0x00,0x00,0x00,0x00,0x00,0x00,0x00,0x00,0x00,0x00,0x00,
 0x00,0x00,0x00,0x00,0x00,0x00,0x00,0x00,0x00,0x00,0x00,0x00,0x00,0x00,0x00,0x00,
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 0x00,0x00,0x00,0x00,0x00,0x00,0x00,0x00,0x00,0x00,0x00,0x00,0x00,0x00,0x00,0x00,
};

static i2c_oled_t i2c_device[I2C_OLED_MAX];

static uint32_t _write_bytes(uint8_t ch, uint32_t addr, const void *buf, uint32_t len);
static void i2c_oled_write_cmd(uint8_t cmd);
static void i2c_oled_write_data(uint8_t data);	

static uint32_t _write_bytes(uint8_t ch, uint32_t addr, const void *buf, uint32_t len)
{
    uint8_t i2c = i2c_device[ch].i2c;

    uint32_t i = 0;
    uint8_t addr_h = 0;

    //i2c_lock(i2c);

    if (i2c_start(i2c) == LCR_OK)
    {

        if (i2c_write_wack(i2c, i2c_device[ch].addr | addr_h) == LCR_OK)                                          // 器件地址，写
        {
            
                if (i2c_write_wack(i2c, addr & 0xff) == LCR_OK)                                                   
                {
                    for (i = 0; i < len; i++)
                    {

                        if (i2c_write_wack(i2c, *((char *)buf + i)) != LCR_OK)
                        {
                            //TASK_LOG(USE_DEBUG_ERROR, ("%s write error : write data\r\n", i2c_device[ch].name));
							printf("%s write error : write data\r\n", i2c_device[ch].name);
                            break; // 写入错误则此次写入操作结束
                        }
                    }
                }
                else
                {
                    //TASK_LOG(USE_DEBUG_ERROR, ("%s write error : low address\r\n", i2c_device[ch].name));
										printf("%s write error : low address\r\n", i2c_device[ch].name);
                }
            
        }
        else
        {
            //TASK_LOG(USE_DEBUG_ERROR, ("%s write error : device address %02x\r\n", i2c_device[ch].name, i2c_device[ch].addr | addr_h));
			printf("%s write error : device address %02x\r\n", i2c_device[ch].name, i2c_device[ch].addr | addr_h);
        }

        i2c_stop(i2c);


        delay_ms(10);       // 等待写入完成 10ms

    }

    return i;
}

/* public fuction */
lcr_err_t i2c_oled_init(uint8_t ch)
{
    if (i2c_device[ch].initialize == 1)
    {
        return LCR_OK;
    }

    if (ch == I2C_OLED_1)
    {
        i2c_device[ch].i2c = I2C_1;
        i2c_device[ch].addr = 0x78;
        i2c_device[ch].name = "oled";
		
		delay_ms(100);
		
		i2c_oled_write_cmd(0xAE); //display off
		i2c_oled_write_cmd(0x20);	//Set Memory Addressing Mode	
		i2c_oled_write_cmd(0x10);	//00,Horizontal Addressing Mode;01,Vertical Addressing Mode;10,Page Addressing Mode (RESET);11,Invalid
		i2c_oled_write_cmd(0xb0);	//Set Page Start Address for Page Addressing Mode,0-7
		i2c_oled_write_cmd(0xc8);	//Set COM Output Scan Direction
		i2c_oled_write_cmd(0x00); //---set low column address
		i2c_oled_write_cmd(0x10); //---set high column address
		i2c_oled_write_cmd(0x40); //--set start line address
		i2c_oled_write_cmd(0x81); //--set contrast control register
		i2c_oled_write_cmd(0xff); //亮度调节 0x00~0xff
		i2c_oled_write_cmd(0xa1); //--set segment re-map 0 to 127
		i2c_oled_write_cmd(0xa6); //--set normal display
		i2c_oled_write_cmd(0xa8); //--set multiplex ratio(1 to 64)
		i2c_oled_write_cmd(0x3F); //
		i2c_oled_write_cmd(0xa4); //0xa4,Output follows RAM content;0xa5,Output ignores RAM content
		i2c_oled_write_cmd(0xd3); //-set display offset
		i2c_oled_write_cmd(0x00); //-not offset
		i2c_oled_write_cmd(0xd5); //--set display clock divide ratio/oscillator frequency
		i2c_oled_write_cmd(0xf0); //--set divide ratio
		i2c_oled_write_cmd(0xd9); //--set pre-charge period
		i2c_oled_write_cmd(0x22); //
		i2c_oled_write_cmd(0xda); //--set com pins hardware configuration
		i2c_oled_write_cmd(0x12);
		i2c_oled_write_cmd(0xdb); //--set vcomh
		i2c_oled_write_cmd(0x20); //0x20,0.77xVcc
		i2c_oled_write_cmd(0x8d); //--set DC-DC enable
		i2c_oled_write_cmd(0x14); //
		i2c_oled_write_cmd(0xaf); //--turn on oled panel

    }

    else
    {
        return LCR_NODEV;
    }

    if (i2c_init(i2c_device[ch].i2c) == LCR_OK)
    {
        delay_ms(100);


            i2c_device[ch].initialize = 1;

            //TASK_LOG(USE_DEBUG_INIT, ("initialize %s\r\n", i2c_device[ch].name));
			printf("initialize %s\r\n", i2c_device[ch].name);
            return LCR_OK;
    }

    return LCR_ERROR;
}


lcr_err_t i2c_oled_close(uint8_t ch)
{


    if (i2c_device[ch].initialize == 1)
    {
        i2c_device[ch].initialize = 0;
        i2c_device[ch].detect = 0;
    }
	
    return LCR_OK;
}

static uint32_t i2c_oled_write(uint8_t ch, uint32_t addr, const void *buf, uint32_t len)
{
    char *p;
		
		p = (char *)buf;
    uint32_t byte_remain = len;
    uint32_t byte_write = 0;
    uint32_t addr_offset = 0;

    do
    {
        byte_write = _write_bytes(ch, addr + addr_offset, p + addr_offset, byte_remain);

        byte_remain -= byte_write;
        addr_offset += byte_write;

        if (byte_write == 0)
        {
            break;
        }
    }
    while (byte_remain > 0);
    return (len - byte_remain);
}


static void i2c_oled_write_cmd(uint8_t cmd)		//写命令
{
	i2c_oled_write(I2C_OLED_1, 0x00, &cmd, sizeof(cmd)); 
}

static void i2c_oled_write_data(uint8_t data) 		//写数据
{
	i2c_oled_write(I2C_OLED_1, 0x40, &data, sizeof(data)); 
}

/**
  * @brief  OLED_SetPos，设置光标
  */
void i2c_oled_setPos(uint8_t x, uint8_t y) //设置起始点坐标
{ 
	i2c_oled_write_cmd(0xb0+y);
	i2c_oled_write_cmd(((x&0xf0)>>4)|0x10);
	i2c_oled_write_cmd((x&0x0f)|0x01);
}

 /**
  * @brief  OLED_Fill，填充整个屏幕
  */
void i2c_oled_fill(uint8_t fill_Data)//全屏填充
{
	uint8_t m,n;
	for(m=0;m<8;m++)
	{
		i2c_oled_write_cmd(0xb0+m);		//page0-page1
		i2c_oled_write_cmd(0x00);		//low column start address
		i2c_oled_write_cmd(0x10);		//high column start address
		for(n=0;n<128;n++)
			{
				i2c_oled_write_data(fill_Data);
			}
	}
}

 /**
  * @brief  OLED_CLS，清屏
  */
void i2c_oled_cls(void)	//清屏
{
	i2c_oled_fill(0x00);
}


 /**
  * @brief  OLED_ON，将OLED从休眠中唤醒
  */
void i2c_oled_wakeup(void)
{
	i2c_oled_write_cmd(0X8D);  //设置电荷泵
	i2c_oled_write_cmd(0X14);  //开启电荷泵
	i2c_oled_write_cmd(0XAF);  //OLED唤醒
}


 /**
  * @brief  OLED_OFF，让OLED休眠 -- 休眠模式下,OLED功耗不到10uA
  */
void i2c_oled_off(void)
{
	i2c_oled_write_cmd(0X8D);  //设置电荷泵
	i2c_oled_write_cmd(0X10);  //关闭电荷泵
	i2c_oled_write_cmd(0XAE);  //OLED休眠
}


 /**
  * @brief  OLED_ShowStr，显示codetab.h中的ASCII字符,有6*8和8*16可选择
  */
void i2c_oled_showstr(uint8_t x, uint8_t y, uint8_t ch[], uint8_t TextSize)
{
	uint8_t c = 0,i = 0,j = 0;
	switch(TextSize)
	{
		case 1:
		{
			while(ch[j] != '\0')
			{
				c = ch[j] - 32;
				if(x > 126)
				{
					x = 0;
					y++;
				}
				i2c_oled_setPos(x,y);
				for(i=0;i<6;i++){
					i2c_oled_write_data(iic_F6x8[c][i]);
				}
				x += 6;
				j++;
			}
		}break;
		case 2:
		{
			while(ch[j] != '\0')
			{
				c = ch[j] - 32;
				if(x > 120)
				{
					x = 0;
					y++;
				}
				i2c_oled_setPos(x,y);
				for(i=0;i<8;i++)
					i2c_oled_write_data(iic_F8X16[c*16+i]);
				i2c_oled_setPos(x,y+1);
				for(i=0;i<8;i++)
					i2c_oled_write_data(iic_F8X16[c*16+i+8]);
				x += 8;
				j++;
			}
		}break;
	}
}

 /**
  * @brief  OLED_ShowCN，显示codetab.h中的汉字,16*16点阵
  */
void i2c_oled_showCN(uint8_t x, uint8_t y, uint8_t N)
{
	uint8_t wm=0;
	uint32_t  adder=32*N;
	i2c_oled_setPos(x , y);
	for(wm = 0;wm < 16;wm++)
	{
		i2c_oled_write_data(iic_F16x16[adder]);
		adder += 1;
	}
	i2c_oled_setPos(x,y + 1);
	for(wm = 0;wm < 16;wm++)
	{
		i2c_oled_write_data(iic_F16x16[adder]);
		adder += 1;
	}
}



 /**
  * @brief  OLED_DrawBMP，显示BMP位图
  */
void i2c_oled_drawBMP(uint8_t x0,uint8_t y0,uint8_t x1,uint8_t y1,uint8_t BMP[])
{
	uint32_t j=0;
	uint8_t x,y;

  if(y1%8==0)
		y = y1/8;
  else
		y = y1/8 + 1;
	for(y=y0;y<y1;y++)
	{
		i2c_oled_setPos(x0,y);
    for(x=x0;x<x1;x++)
		{
			i2c_oled_write_data(BMP[j++]);
		}
	}
}
